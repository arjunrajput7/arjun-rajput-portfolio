## yocto-meta-custom-bsp/meta-custom-bsp/conf/layer.conf
```bitbake
# Layer configuration for meta-custom-bsp
BBPATH .= ":${LAYERDIR}"

BBFILES += "${LAYERDIR}/recipes-*/*/*.bb \
            ${LAYERDIR}/recipes-*/*/*.bbappend"

BBFILE_COLLECTIONS += "meta-custom-bsp"
BBFILE_PATTERN_meta-custom-bsp = "^${LAYERDIR}/"
BBFILE_PRIORITY_meta-custom-bsp = "10"

LAYERDEPENDS_meta-custom-bsp = "core"
LAYERSERIES_COMPAT_meta-custom-bsp = "kirkstone scarthgap styhead walnascar"
```
